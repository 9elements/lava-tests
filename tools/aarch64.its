## tools/aarch64.its
```
/dts-v1/;

/ {
	description = "Simple image with single Linux kernel and FDT blob";
	#address-cells = <1>;

	images {
		kernel {
			description = "Vanilla Linux kernel";
			data = /incbin/("tmp/kernel.lzma");
			type = "kernel";
			arch = "aarch64";
			os = "linux";
			compression = "lzma";
			load = <0x80000000>;
			entry = <0x80000000>;
			hash-1 {
				algo = "crc32";
			};
		};
		fdt-1 {
			description = "Flattened Device Tree blob";
			data = /incbin/("tmp/file.dtb");
			type = "flat_dt";
			arch = "aarch64";
			compression = "none";
			hash-1 {
				algo = "crc32";
			};
		};
		ramdisk-1 {
			description = "Compressed Initramfs";
			data = /incbin/("./tmp/initramfs.cpio.xz");
			type = "ramdisk";
			arch = "arm64";
			os = "linux";
			compression = "none";
			load = <00000000>;
			entry = <00000000>;
			hash-1 {
				algo = "sha1";
			};
		};
	};

	configurations {
		default = "conf-1";
		conf-1 {
			description = "Boot Linux kernel with FDT blob";
			kernel = "kernel";
			fdt = "fdt-1";
			ramdisk = "ramdisk-1";
		};
	};
};
```
